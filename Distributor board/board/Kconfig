## Distributor board/board/Kconfig
```kconfig
menu "Hardware Drivers Config"

config SOC_STM32F103C8
    bool
    select SOC_SERIES_STM32F1
    select RT_USING_COMPONENTS_INIT
    select RT_USING_USER_MAIN
    default y

menu "Onboard Peripheral Drivers"

endmenu

menu "On-chip Peripheral Drivers"

    config BSP_USING_GPIO
        bool "Enable GPIO"
        select RT_USING_PIN
        default y

    config BSP_USING_SPI1
        bool "Enable SPI1 BUS"
        select RT_USING_SPI
        default y	
        
    menuconfig BSP_USING_PWM
        bool "Enable pwm"
        default y
        select RT_USING_PWM
        if BSP_USING_PWM
        menuconfig BSP_USING_PWM1
            bool "Enable timer1 output pwm"
            default y
            if BSP_USING_PWM1
                config BSP_USING_PWN1_CH1
                    bool "Enable PWM1 channel1"
                    default y
                config BSP_USING_PWN1_CH2
                    bool "Enable PWM1 channel2"
                    default y
                config BSP_USING_PWN1_CH3
                    bool "Enable PWM1 channel3"
                    default y
                config BSP_USING_PWN1_CH4
                    bool "Enable PWM1 channel4"
                    default y
            endif
        
        menuconfig BSP_USING_PWM2
            bool "Enable timer2 output pwm"
            default y
            if BSP_USING_PWM2
                config BSP_USING_PWN2_CH1
                    bool "Enable PWM1 channel1"
                    default y
                config BSP_USING_PWN2_CH2
                    bool "Enable PWM1 channel2"
                    default y
                config BSP_USING_PWN2_CH3
                    bool "Enable PWM1 channel3"
                    default y
                config BSP_USING_PWN2_CH4
                    bool "Enable PWM1 channel4"
                    default y
            endif

        menuconfig BSP_USING_PWM3
            bool "Enable timer3 output pwm"
            default y
            if BSP_USING_PWM3
                config BSP_USING_PWN3_CH1
                    bool "Enable PWM1 channel1"
                    default y
                config BSP_USING_PWN3_CH2
                    bool "Enable PWM1 channel2"
                    default y
                config BSP_USING_PWN3_CH3
                    bool "Enable PWM1 channel3"
                    default y
                config BSP_USING_PWN3_CH4
                    bool "Enable PWM1 channel4"
                    default y
            endif

        endif

    menuconfig BSP_USING_UART
        bool "Enable UART"
        default y
        select RT_USING_SERIAL
        if BSP_USING_UART
            config BSP_USING_UART1
                bool "Enable UART1"
                default y

            config BSP_UART1_RX_USING_DMA
                bool "Enable UART1 RX DMA"
                depends on BSP_USING_UART1 && RT_SERIAL_USING_DMA
                default n
        endif

    menuconfig BSP_USING_CAN
        bool "Enable CAN"
        default n
        select RT_USING_CAN
        if BSP_USING_CAN
            config BSP_USING_CAN1
                bool "Enable CAN1"
                default n

            config RT_CAN_USING_HDR
                bool "Enable CAN RX HDR"
                depends on BSP_USING_CAN && BSP_USING_CAN1
                default n
        endif

    menuconfig BSP_USING_I2C
        bool "Enable I2C"
        default n
        select RT_USING_I2C
        if BSP_USING_I2C
            config BSP_USING_I2C2
                bool "Enable I2C2"
                default n
        endif

    source "../../libraries/HAL_Drivers/Kconfig"
       
endmenu

menu "Board extended module Drivers"

endmenu

endmenu
```

## chassis/applications/Kconfig
```kconfig
menu "Car Customize Config"

#是否使用超级电容限制
menuconfig USE_CAPACITY
    bool "Use Super Capacity"
    default n

#是否使能底盘同步
menuconfig MOTOR_USE_SYNC
    bool "Use Chassis Synchronization"
    default n

menu "Choose Car model Config"
    
    #选择兵种
    choice
        prompt "select Types of arms" 
        default CORE_USING_INFANTRY
        config CORE_USING_INFANTRY
            bool "infantry"
        config CORE_USING_HERO
            bool "hero"
    endchoice


    选择英雄机器人
    if  CORE_USING_HERO
        choice
            prompt "select Types of hero robot" 
            default CORE_USING_BLACKHEAD_HERO
            #黑头英雄
            config CORE_USING_BLACKHEAD_HERO
                bool "21 black head hero"
            #C板英雄
            config CORE_USING_C_BOARD_HERO
                bool "21 C board hero"
            #国赛英雄
            config CORE_USING_NATION_HERO
                bool "21 nation hero"
            #22双马尾英雄
            config CORE_USING_BUNCHES_HERO
                bool "22 bunches hero"
        endchoice
    endif


    选择步兵机器人
    if  CORE_USING_INFANTRY
        choice
            prompt "select Types of infantry robot" 
            default CORE_USING_BLACKHEAD_INFANTRY
            #黑头步兵
            config CORE_USING_BLACKHEAD_INFANTRY
                bool "21 black head infantry"
            #绿头步兵
            config CORE_USING_GREENHEAD_INFANTRY
                bool "21 green head infantry"    
            #小步兵
            config CORE_USING_SMALL_INFANTRY
                bool "21 small infantry"
            #全向轮步兵
            config CORE_USING_OMNI_WHEEL_INFANTRY
                bool "21 omni wheel infantry"
            #国赛祥云步兵(第一辆)(碳板步兵)
            config CORE_USING_CLOUD_INFANTRY1
                bool "21 cloud infantry 1(Carbon Plate Infantry)"
            #国赛祥云步兵(第二辆)
            config CORE_USING_CLOUD_INFANTRY2
                bool "21 cloud infantry 2"
            #22富贵步兵
            config CORE_USING_RICH_INFANTRY
                bool "22 rich infantry"
            #22玻头步兵
            config CORE_USING_GLASS_INFANTRY
                bool "22 glass infantry"
        endchoice
    endif
    
    #底盘选取麦轮or全向轮
    choice
        prompt "select chassis kind"
        default MECANUM_WHEEL
        config MECANUM_WHEEL
            bool "select mecanum"
        if CORE_USING_INFANTRY      #if语句的 或 用 ||
            config OMNI_WHEEL
                bool "select omnidirectional"
        endif
    endchoice

    #轮子选取3508驱动or2006驱动
    choice
        prompt "select wheel motor kind"
        default WHEEL_MOTOR_3508
        config WHEEL_MOTOR_3508
            bool "select RM 3508"
        config WHEEL_MOTOR_2006
            bool "select RM 2006"
    endchoice


endmenu

endmenu
```

## super_capacity/board/Kconfig
```kconfig
menu "Hardware Drivers Config"

config SOC_STM32F103RC
    bool
    select SOC_SERIES_STM32F1
    select RT_USING_COMPONENTS_INIT
    select RT_USING_USER_MAIN
    default y

menu "Onboard Peripheral Drivers"

endmenu

menu "On-chip Peripheral Drivers"

    config BSP_USING_GPIO
        bool "Enable GPIO"
        select RT_USING_PIN
        default y

    menuconfig BSP_USING_UART
        bool "Enable UART"
        default y
        select RT_USING_SERIAL
        if BSP_USING_UART
            config BSP_USING_UART1
                bool "Enable UART1"
                default y

            config BSP_UART1_RX_USING_DMA
                bool "Enable UART1 RX DMA"
                depends on BSP_USING_UART1 && RT_SERIAL_USING_DMA
                default n
        endif

    menuconfig BSP_USING_PWM
        bool "Enable pwm"
        default y
        select RT_USING_PWM
        if BSP_USING_PWM
        menuconfig BSP_USING_PWM3
            bool "Enable timer3 output pwm"
            default y
            if BSP_USING_PWM3
                config BSP_USING_PWM3_CH1
                    bool "Enable PWM3 channel1(PC6)"
                    default y

            endif
        endif

    menuconfig BSP_USING_CAN
        bool "Enable CAN"
        default y
        select RT_USING_CAN
        if BSP_USING_CAN
            config BSP_USING_CAN1
                bool "Enable CAN1"
                default y

            config RT_CAN_USING_HDR
                bool "Enable CAN RX HDR"
                depends on BSP_USING_CAN && BSP_USING_CAN1
                default n
        endif

    menuconfig BSP_USING_ADC
        bool "Enable ADC"
        default y
        select RT_USING_ADC
        if BSP_USING_ADC
            config BSP_USING_ADC1
                bool "Enable ADC1"
                default y
        endif

    menuconfig BSP_USING_DAC
        bool "Enable DAC"
        default y
        select RT_USING_DAC
        if BSP_USING_DAC
            config RT_USING_DAC1
                bool "Enable DAC1"
                default y
        endif

    menuconfig BSP_USING_I2C2
        bool "Enable I2C2 BUS"
        default y
        select RT_USING_I2C
        select RT_USING_PIN
        if BSP_USING_I2C2
            config BSP_I2C2_SCL_PIN
                int "i2c2 scl pin number"
                range 0 63
                default 26
            config BSP_I2C2_SDA_PIN
                int "I2C2 sda pin number"
                range 0 63
                default 27
        endif

    menuconfig BSP_USING_TIM
        bool "Enable timer"
        default y
        select RT_USING_HWTIMER
        if BSP_USING_TIM
            config BSP_USING_TIM2
                bool "Enable TIM2"
                default y

            config BSP_USING_TIM3
                bool "Enable TIM3"
                default n

            config BSP_USING_TIM4
                bool "Enable TIM4"
                default n
        endif

    menuconfig CORE_USING_MONITOR
        bool "Enable wdg"
        default n
        if CORE_USING_MONITOR
            config BSP_USING_WDT
                bool "Enable hardware wdg"
                select RT_USING_WDT
                default n
        endif

    source "../../libraries/HAL_Drivers/Kconfig"
       
endmenu

menu "Board extended module Drivers"

endmenu

endmenu
```
